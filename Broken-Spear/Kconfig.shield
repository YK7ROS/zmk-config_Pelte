## Broken-Spear/Kconfig.shield
```kconfig
# Copyright (c) 2020 The ZMK Contributors
# SPDX-License-Identifier: MIT

config SHIELD_Broken-Spear
    def_bool $(shields_list_contains,Broken-Spear)
```

## config/Shield_Broken-Spear/Kconfig.defconfig
```kconfig
# Copyright (c) 2020 The ZMK Contributors
# SPDX-License-Identifier: MIT

if SHIELD_Broken-Spear

config ZMK_KEYBOARD_NAME
    default "Broken-Spear"

endif
```

## config/boards/shields/Pelte/Kconfig.defconfig
```kconfig
# Copyright (c) 2020 The ZMK Contributors
# SPDX-License-Identifier: MIT

if SHIELD_Pelte

config ZMK_KEYBOARD_NAME
    default "Pelte"

endif
```

## config/boards/shields/Pelte/Kconfig.shield
```kconfig
# Copyright (c) 2020 The ZMK Contributors
# SPDX-License-Identifier: MIT

config SHIELD_Pelte
    def_bool $(shields_list_contains,Pelte)
```

## config/west.yml
```yaml
manifest:
  remotes:
    - name: zmkfirmware
      url-base: https://github.com/zmkfirmware
    - name: YK7ROS
      url-base: https://github.com/YK7ROS
  projects:
    - name: zmk
      remote: zmkfirmware
      revision: main
      import: app/west.yml
  self:
    path: config
    
```
